## west.yml
```yaml
manifest:
  remotes:
    - name: dndg
      url-base: https://github.com/dndg
    - name: zephyrproject-rtos
      url-base: https://github.com/zephyrproject-rtos
  projects:
    - name: zephyr
      remote: zephyrproject-rtos
      revision: v3.1.0
      import:
        name-allowlist:
          - hal_cmsis
          - hal_infineon
          - hal_stm32
          - fs_fatfs
          - fs_littlefs
          - lib_zcbor
  self:
    path: opta-zephyr-examples
```
